## conf/machine/include/imx61.inc
```bitbake
require conf/machine/include/tune-cortexa9.inc

PREFERRED_PROVIDER_virtual/bootloader = "u-boot-imx"
PREFERRED_PROVIDER_virtual/kernel = "linux-novena"

# Increase this everytime you change something in the kernel
MACHINE_KERNEL_PR = "r0"
KERNEL_IMAGETYPE = "uImage"
KERNEL_ALT_IMAGETYPE = "LOADADDR=0x10008000"

EXTRA_IMAGEDEPENDS += "u-boot-imx makedisk-native genfatfs-native"
UBOOT_MACHINE = "mx6qsabrelite_config"
UBOOT_SUFFIX = "imx"
UBOOT_MAKE_TARGET = "u-boot.imx"

IMAGE_ROOTFS_SIZE = "512000"
IMAGE_FSTYPES += "ext3"

KERNEL_DEVICETREE = "arch/arm/boot/dts/novena.dts"
IMAGE_POSTPROCESS_COMMAND += "novena_make_rom;"

novena_make_rom() {
    install -d ${DEPLOY_DIR_IMAGE}
    # Create the boot partition
    rm -rf ${DEPLOY_DIR_IMAGE}/fat-boot
    mkdir -p ${DEPLOY_DIR_IMAGE}/fat-boot
    cp ${DEPLOY_DIR_IMAGE}/uImage-${MACHINE}.bin ${DEPLOY_DIR_IMAGE}/fat-boot/
    cp ${DEPLOY_DIR_IMAGE}/uImage-novena.dtb ${DEPLOY_DIR_IMAGE}/fat-boot/
    cp ${DEPLOY_DIR_IMAGE}/boot.scr ${DEPLOY_DIR_IMAGE}/fat-boot/
    genfatfs -d ${DEPLOY_DIR_IMAGE}/fat-boot -b 32768 boot-${MACHINE}.vfat

    # Generate the disk image.  Pad the first partition with 512k for U-Boot
    makedisk -o ${DEPLOY_DIR_IMAGE}/rom-${MACHINE}-${IMAGE_BASENAME}.img \
             -p 512K \
             -a 16M:0x0b:${DEPLOY_DIR_IMAGE}/boot-${MACHINE}.vfat \
             -a ${ROOTFS_SIZE}k:0x83:${DEPLOY_DIR_IMAGE}/${IMAGE_LINK_NAME}.ext3

    # Slot the U-Boot image into the first 512k (after the first 1024 bytes)
    dd if=${DEPLOY_DIR_IMAGE}/${UBOOT_MAKE_TARGET} \
       of=${DEPLOY_DIR_IMAGE}/rom-${MACHINE}-${IMAGE_BASENAME}.img \
       bs=512 \
       conv=notrunc \
       seek=2

    # Compress ROM image
    rm -f ${DEPLOY_DIR_IMAGE}/rom-${MACHINE}-${IMAGE_BASENAME}.img.gz
    /bin/gzip ${DEPLOY_DIR_IMAGE}/rom-${MACHINE}-${IMAGE_BASENAME}.img
}
```

## conf/machine/include/pxa168.inc
```bitbake
SOC_FAMILY = "pxa168"

require conf/machine/include/tune-arm926ejs.inc

# Increase this everytime you change something in the kernel
MACHINE_KERNEL_PR = "r30"


PREFERRED_PROVIDER_virtual/kernel = "linux-silvermoon"

KERNEL_IMAGETYPE = "zImage"

SERIAL_CONSOLE = "115200 ttyS0"

#UBOOT_ENTRYPOINT = "0x80008000"
#UBOOT_LOADADDRESS = "0x80008000"

EXTRA_IMAGEDEPENDS += "u-boot silvermoon-blobs makedisk-native config-util-native regutil compat-wireless-ath9k-htc ath9k-firmware"

# Match current Silvermoon devices
IMAGE_ROOTFS_SIZE = "512000"

IMAGE_POSTPROCESS_COMMAND += "kosagi_make_rom;"

kosagi_make_rom() {
    install -d ${DEPLOY_DIR_IMAGE}

    # Create the config block header
    config_util --cmd=create \
        --mbr=/dev/zero \
        --configname=kovan \
        --build_ver=1000 --force --pad \
        --blockdef=${DEPLOY_DIR_IMAGE}/u-boot-${MACHINE}.bin,1507328,u-bt,1,0,0,0 \
        --blockdef=${DEPLOY_DIR_IMAGE}/zImage-${MACHINE}.bin,3932160,krnA,1,0,0,0 \
        --blockdef=/dev/null,3932160,krnB,1,0,0,0 \
        --blockdef=/dev/null,16384,cpid,1,0,0,0 \
        --blockdef=/dev/null,1024,dcid,1,0,0,0 \
        --blockdef=${DEPLOY_DIR_IMAGE}/logo.raw565.gz,153600,logo,1,0,0,0 \
        --blockdef=${DEPLOY_DIR_IMAGE}/kovan-lx9.bit,340992,LX9,1,0,0,0 \
        --blockdef=${DEPLOY_DIR_IMAGE}/kovan-lx45.bit,1484800,LX45,1,0,0,0 \
        > ${DEPLOY_DIR_IMAGE}/config_block.bin


    # Populate the config block
    rm -f ${DEPLOY_DIR_IMAGE}/boot-${MACHINE}.bin
    touch ${DEPLOY_DIR_IMAGE}/boot-${MACHINE}.bin
    dd conv=notrunc of=${DEPLOY_DIR_IMAGE}/boot-${MACHINE}.bin seek=0 count=96 if=${DEPLOY_DIR_IMAGE}/obm.bin
    dd conv=notrunc of=${DEPLOY_DIR_IMAGE}/boot-${MACHINE}.bin seek=96 count=32 if=${DEPLOY_DIR_IMAGE}/config_block.bin
    dd conv=notrunc of=${DEPLOY_DIR_IMAGE}/boot-${MACHINE}.bin seek=128 count=2944 if=${DEPLOY_DIR_IMAGE}/u-boot-${MACHINE}.bin
    dd conv=notrunc of=${DEPLOY_DIR_IMAGE}/boot-${MACHINE}.bin seek=3072 count=7680 if=${DEPLOY_DIR_IMAGE}/zImage-${MACHINE}.bin
    dd conv=notrunc of=${DEPLOY_DIR_IMAGE}/boot-${MACHINE}.bin seek=10752 count=7680 if=/dev/null	# krnB
    dd conv=notrunc of=${DEPLOY_DIR_IMAGE}/boot-${MACHINE}.bin seek=18432 count=32 if=/dev/null	# cpid
    dd conv=notrunc of=${DEPLOY_DIR_IMAGE}/boot-${MACHINE}.bin seek=18464 count=2 if=/dev/null	# dcid
    dd conv=notrunc of=${DEPLOY_DIR_IMAGE}/boot-${MACHINE}.bin seek=18466 count=300 if=${DEPLOY_DIR_IMAGE}/logo.raw565.gz 	# logo
    dd conv=notrunc of=${DEPLOY_DIR_IMAGE}/boot-${MACHINE}.bin seek=18766 count=666 if=${DEPLOY_DIR_IMAGE}/kovan-lx9.bit
    dd conv=notrunc of=${DEPLOY_DIR_IMAGE}/boot-${MACHINE}.bin seek=19432 count=2900 if=${DEPLOY_DIR_IMAGE}/kovan-lx45.bit



    # Make full boot ROM
    rm -f ${DEPLOY_DIR_IMAGE}/rom-${MACHINE}-${IMAGE_BASENAME}.img.gz
    makedisk -o ${DEPLOY_DIR_IMAGE}/rom-${MACHINE}-${IMAGE_BASENAME}.img \
             -a 16M:0x53:${DEPLOY_DIR_IMAGE}/boot-${MACHINE}.bin \
             -a ${ROOTFS_SIZE}k:0x83:${DEPLOY_DIR_IMAGE}/${IMAGE_LINK_NAME}.ext3
    gzip ${DEPLOY_DIR_IMAGE}/rom-${MACHINE}-${IMAGE_BASENAME}.img
}
```

## conf/machine/kovan.conf
```bitbake
#@TYPE: Machine
#@NAME: Kovan machine
#@DESCRIPTION: Machine configuration for the Kovan development platform

PREFERRED_PROVIDER_virtual/xserver = "xserver-xorg"
XSERVER = "xserver-xorg \
           xf86-input-evdev \
           xf86-video-fbdev"

# Only has DVI connector for external screen
GUI_MACHINE_CLASS = "smallscreen"

require conf/machine/include/pxa168.inc

PREFERRED_PROVIDER_virtual/kernel = "linux-silvermoon"
TASK_BASIC_SSHDAEMON = "openssh-sshd openssh-sftp openssh-sftp-server openssh-scp"

IMAGE_INSTALL_append += "compat-wireless-ath9k-htc ath9k-firmware \
			 regutil config-util kernel-module-kovan-xilinx"

IMAGE_FSTYPES += "ext3"

# Guesswork
SERIAL_CONSOLE = "115200 ttyS0"

UBOOT_MACHINE = "aspenite_config"

# and sdio
MACHINE_FEATURES = "kernel26 screen apm usbgadget usbhost vfat alsa"
```

## conf/machine/novena.conf
```bitbake
#@TYPE: Machine
#@NAME: Kovan machine
#@DESCRIPTION: Machine configuration for the Kovan development platform

PREFERRED_PROVIDER_virtual/xserver = "xserver-xorg"
XSERVER = "xserver-xorg \
           xf86-input-evdev \
           xf86-video-fbdev"

# Only has DVI connector for external screen
GUI_MACHINE_CLASS = "smallscreen"

require conf/machine/include/imx61.inc

PREFERRED_PROVIDER_virtual/kernel = "linux-novena"
 # hmm....either that or systemd, eh?
PREFERRED_PROVIDER_udev = "udev"

TASK_BASIC_SSHDAEMON = "openssh-sshd openssh-sftp openssh-sftp-server openssh-scp"

SERIAL_CONSOLE = "115200 ttymxc1"

UBOOT_MACHINE = "novena_config"

MACHINE_FEATURES = "kernel26 screen apm usbgadget usbhost vfat alsa"
```

## conf/machine/pxa168.inc
```bitbake
SOC_FAMILY = "pxa168"

require conf/machine/include/tune-arm926ejs.inc
require conf/machine/include/tune-iwmmxt.inc

PREFERRED_PROVIDER_virtual/kernel = "linux-silvermoon"
# Increase this everytime you change something in the kernel
MACHINE_KERNEL_PR = "r0"

KERNEL_IMAGETYPE = "uImage"

#UBOOT_ENTRYPOINT = "0x80008000"
#UBOOT_LOADADDRESS = "0x80008000"

EXTRA_IMAGEDEPENDS += "u-boot-silvermoon chumby-blobs-silvermoon"

# Match current Silvermoon devices
IMAGE_ROOTFS_SIZE = "512000"

chumby_make_rom_chumby-silvermoon-netv () {
    install -d ${DEPLOY_DIR_IMAGE}

    # Create the config block header
    config_util --cmd=create \
        --mbr=/dev/zero \
        --configname=${CNPLATFORM} \
        --build_ver=${CHUMBY_BUILD} --force --pad \
        --blockdef=${DEPLOY_DIR_IMAGE}/u-boot-${MACHINE}.bin,1507328,u-bt,1,0,0,0 \
        --blockdef=${DEPLOY_DIR_IMAGE}/zImage-${MACHINE}.bin,3932160,krnA,1,0,0,0 \
        --blockdef=${DEPLOY_DIR_IMAGE}/recovery-mode,3932160,krnB,1,0,0,0 \
        --blockdef=/dev/null,16384,cpid,1,0,0,0 \
        --blockdef=/dev/null,1024,dcid,1,0,0,0 \
        --blockdef=/dev/null,340992,720p,1,0,0,0 \
        --blockdef=/dev/null,1843200,logo,1,0,0,0 \
        > ${DEPLOY_DIR_IMAGE}/config_block.bin


    # Populate the config block
    rm -f ${DEPLOY_DIR_IMAGE}/boot-${MACHINE}.bin
    touch ${DEPLOY_DIR_IMAGE}/boot-${MACHINE}.bin
    dd conv=notrunc of=${DEPLOY_DIR_IMAGE}/boot-${MACHINE}.bin seek=0 count=96 if=${DEPLOY_DIR_IMAGE}/obm.bin
    dd conv=notrunc of=${DEPLOY_DIR_IMAGE}/boot-${MACHINE}.bin seek=96 count=32 if=${DEPLOY_DIR_IMAGE}/config_block.bin
    dd conv=notrunc of=${DEPLOY_DIR_IMAGE}/boot-${MACHINE}.bin seek=128 count=2944 if=${DEPLOY_DIR_IMAGE}/u-boot-${MACHINE}.bin
    dd conv=notrunc of=${DEPLOY_DIR_IMAGE}/boot-${MACHINE}.bin seek=3072 count=7680 if=${DEPLOY_DIR_IMAGE}/uImage-${MACHINE}.bin
    dd conv=notrunc of=${DEPLOY_DIR_IMAGE}/boot-${MACHINE}.bin seek=10752 count=7680 if=${DEPLOY_DIR_IMAGE}/recovery-mode
    dd conv=notrunc of=${DEPLOY_DIR_IMAGE}/boot-${MACHINE}.bin seek=18466  count=666 if=${DEPLOY_DIR_IMAGE}/hdmi_720p.bin
    dd conv=notrunc of=${DEPLOY_DIR_IMAGE}/boot-${MACHINE}.bin seek=19132 count=3600 if=${DEPLOY_DIR_IMAGE}/logo-preparing.raw.gz

    package_stagefile_shell ${DEPLOY_DIR_IMAGE}/boot-${MACHINE}.bin



    # Make full boot ROM
    rm -f ${DEPLOY_DIR_IMAGE}/rom-${MACHINE}-${IMAGE_BASENAME}.img.gz
    makedisk -o ${DEPLOY_DIR_IMAGE}/rom-${MACHINE}-${IMAGE_BASENAME}.img \
             -a 16M:0x53:${DEPLOY_DIR_IMAGE}/boot-${MACHINE}.bin \
             -a ${ROOTFS_SIZE}k:0x83:${DEPLOY_DIR_IMAGE}/${IMAGE_LINK_NAME}.ext3
    gzip ${DEPLOY_DIR_IMAGE}/rom-${MACHINE}-${IMAGE_BASENAME}.img
}
```
